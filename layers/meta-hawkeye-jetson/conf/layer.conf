## layers/meta-hawkeye-jetson/conf/layer.conf
```bitbake
BBPATH .= ":${LAYERDIR}"

BBFILES += "${LAYERDIR}/recipes-*/*/*.bb \
            ${LAYERDIR}/recipes-*/*/*.bbappend"

BBFILE_COLLECTIONS += "hawkeye-jetson"
BBFILE_PATTERN_hawkeye-jetson = "^${LAYERDIR}/"
BBFILE_PRIORITY_hawkeye-jetson = "200"
LAYERSERIES_COMPAT_hawkeye-jetson = "dunfell"

# tegra-demo-distro uses the dunfell branch with older recipies
BBMASK += "tegra-demo-distro/.*/mender-client"
# broken for feature branches
BBMASK += "meta-mender/meta-mender-core/recipes-mender/mender-client/mender-client_git.bb"

BBMASK += "meta-mender-community/meta-mender-tegra/recipes-bsp/u-boot/u-boot-tegra_%.bbappend"
```

## layers/meta-hawkeye-jetson/conf/machine/boxer-8251.conf
```bitbake
#@TYPE: Machine
##@NAME: boxer-8251
##@DESCRIPTION: Machine configuration for the AAEON BOXER-8251AI

include conf/machine/jetson-xavier-nx-devkit-emmc.conf

# Remove $MACHINE which is prepended by including jetson-xavier-nx-devkit
# and fix the order of overrides
MACHINEOVERRIDES := "${@'${MACHINEOVERRIDES}'.replace(':${MACHINE}',':jetson-xavier-nx-devkit-emmc:boxer-nx:${MACHINE}')}"
```

## layers/meta-hawkeye-jetson/conf/machine/photon-nano.conf
```bitbake
#@TYPE: Machine
##@NAME: photon-nano
##@DESCRIPTION: Machine configuration for the CTI Photon Carrier Board for Nvidia Jetson Nano

MACHINEOVERRIDES = "jetson-nano:photon:${MACHINE}"
require conf/machine/jetson-nano-emmc.conf

PACKAGE_EXTRA_ARCHS_append = " jetson-nano-emmc"
KERNEL_DEVICETREE = "_ddot_/_ddot_/_ddot_/_ddot_/nvidia/platform/t210/porg/kernel-dts/tegra210-nano-cti-NGX003.dtb"

# Necessary for some PCIe wifi adapters to work.
KERNEL_ARGS_append = " pcie_aspm.policy=performance"
```

## layers/meta-hawkeye-jetson/conf/machine/photon-xavier-nx.conf
```bitbake
#@TYPE: Machine
#@NAME: CTI Photon Xavier NX
##@DESCRIPTION: CTI Photon Carrier Board for Nvidia Jetson Xavier NX
#

MACHINEOVERRIDES = "jetson-xavier-nx-devkit-emmc:${MACHINE}"
include conf/machine/jetson-xavier-nx-devkit-emmc.conf

# work-around for https://github.com/OE4T/meta-tegra/issues/400
MACHINEOVERRIDES := "${@'${MACHINEOVERRIDES}'.replace(':${MACHINE}',':jetson-xavier-nx-devkit-emmc:photon:${MACHINE}')}"

PACKAGE_EXTRA_ARCHS_append = " jetson-xavier-nx-devkit-emmc"
KERNEL_DEVICETREE = "_ddot_/_ddot_/_ddot_/_ddot_/nvidia/platform/t19x/jakku/kernel-dts/tegra194-xavier-nx-cti-NGX003.dtb"

# XXX Building t19x c-boot from source is currently broken
PREFERRED_PROVIDER_virtual/bootloader = "cboot-prebuilt"
```
